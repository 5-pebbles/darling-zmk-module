## boards/shields/darling/Kconfig.defconfig
```kconfig
if SHIELD_DARLING_LEFT

# Name must be less than 16 characters long!
config ZMK_KEYBOARD_NAME
    default "Darling"

config ZMK_SPLIT_ROLE_CENTRAL
    default y

endif

if SHIELD_DARLING_LEFT || SHIELD_DARLING_RIGHT

config ZMK_SETTINGS_RESET_ON_START
    default y

config ZMK_POINTING
    default y

config USB_DEVICE_MANUFACTURER
    default "Owen Friedman"

config BT_DIS_MANUF
    default "Owen Friedman"

config ZMK_SPLIT
    default y

endif
```

## boards/shields/darling/Kconfig.shield
```kconfig
config SHIELD_DARLING_LEFT
    def_bool $(shields_list_contains,darling_left)

config SHIELD_DARLING_RIGHT
    def_bool $(shields_list_contains,darling_right)
```

## boards/shields/seraph/Kconfig.defconfig
```kconfig
if SHIELD_SERAPH_LEFT

# Name must be less than 16 characters long!
config ZMK_KEYBOARD_NAME
    default "Seraph"

config ZMK_SPLIT_ROLE_CENTRAL
    default y

endif

if SHIELD_SERAPH_LEFT || SHIELD_SERAPH_RIGHT

config ZMK_SETTINGS_RESET_ON_START
    default y

config ZMK_POINTING
    default y

config USB_DEVICE_MANUFACTURER
    default "Owen Friedman"

config BT_DIS_MANUF
    default "Owen Friedman"

config ZMK_SPLIT
    default y

endif
```

## boards/shields/seraph/Kconfig.shield
```kconfig
config SHIELD_SERAPH_LEFT
    def_bool $(shields_list_contains,seraph_left)

config SHIELD_SERAPH_RIGHT
    def_bool $(shields_list_contains,seraph_right)
```
